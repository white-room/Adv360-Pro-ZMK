#define VERSION_MACRO
macro_ver: macro_ver {
compatible = "zmk,behavior-macro";
#binding-cells = <0>;
bindings = <&kp N2>, <&kp N0>, <&kp N2>, <&kp N5>, <&kp N0>, <&kp N6>, <&kp N2>, <&kp N3>, <&kp MINUS>, <&kp V>, <&kp N3>, <&kp DOT>, <&kp N0>, <&kp MINUS>, <&kp N0>, <&kp N9>, <&kp N1>, <&kp A>, <&kp N5>, <&kp D>, <&kp N4>, <&kp MINUS>, <&kp DOT>, <&kp RET>;
};
